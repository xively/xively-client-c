## examples/esp32/xively_demo/sdkconfig.defaults
```kconfig
# Module info
CONFIG_ESPTOOLPY_FLASHSIZE_4MB=y

# Reduce bootloader log verbosity
CONFIG_LOG_BOOTLOADER_LEVEL_WARN=y
CONFIG_LOG_BOOTLOADER_LEVEL=2

# Increase main task stack size
CONFIG_MAIN_TASK_STACK_SIZE=6144

# IDF's SNTP Implementation
CONFIG_LWIP_DHCP_MAX_NTP_SERVERS=4

# Enable filesystem
CONFIG_PARTITION_TABLE_CUSTOM=y
CONFIG_PARTITION_TABLE_CUSTOM_FILENAME="xi_demo_partitions.csv"
CONFIG_PARTITION_TABLE_CUSTOM_APP_BIN_OFFSET=0x10000
CONFIG_PARTITION_TABLE_FILENAME="xi_demo_partitions.csv"
CONFIG_APP_OFFSET=0x10000

# Configure FAT filesystem
CONFIG_FATFS_CODEPAGE_437=y
CONFIG_FATFS_CODEPAGE=437
# FAT Long Filename config
CONFIG_FATFS_LFN_NONE=
CONFIG_FATFS_LFN_HEAP=y
CONFIG_FATFS_LFN_STACK=
CONFIG_FATFS_MAX_LFN=255
```
